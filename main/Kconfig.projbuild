## main/Kconfig.projbuild
```kconfig
menu "WiFi Configuration"
    config ESP_WIFI_SSID
        string "WiFi SSID"
        default "myssid"
        help
            SSID (network name) for the example to connect to.

    config ESP_WIFI_PASSWORD
        string "WiFi Password"
        default "mypassword"
        help
            WiFi password (WPA or WPA2) for the example to use.

    config ESP_MAXIMUM_RETRY
        int "Maximum retry"
        default 5
        help
            Set the Maximum retry attempts for reconnecting to the AP.

endmenu

menu "Electricity API Configuration"
    config ELEC_API_URL
        string "API URL"
        default "https://api.porssisahko.net/v1/latest-prices.json"
        help
            URL for the Electricity API
    config ELEC_LOW_PRICE
        int "Low price range"
        default 5
        help
            Anything below this is considered low
    config ELEC_HIGH_PRICE
        int "High price range"
        default 15
        help
            Anything above this is considered high, in between low and high is medium
    config ELEC_BTN_NEXT
        int "Cycle next item"
        default 25
    config ELEC_BTN_PREV
        int "Cycle previous item"
        default 33     
    config ELEC_BUTTON_INACTIVITY_RESET_SEC
        int "Timeout in seconds"
        default 10
    config ELEC_RESET_DISPLAY_PERIODICALLY_SEC
        int "Period to reset the display in seconds"
        default 60   
    config ELEC_FETCH_PRICES_PERIODICALLY_HOURS
        int "Period to fetch new prices (overrides the old prices) in hours"
        default 2
endmenu
```
